## conf/layer.conf
```bitbake
# We have a conf and classes directory, append to BBPATH
BBPATH .= ":${LAYERDIR}"

# We have a recipes directory, add to BBFILES
BBFILES += "${LAYERDIR}/recipes-*/*.bb ${LAYERDIR}/recipes-*/*.bbappend \
            ${LAYERDIR}/recipes-*/*/*.bb ${LAYERDIR}/recipes-*/*/*.bbappend \
            ${LAYERDIR}/recipes-*/*/*/*.bb ${LAYERDIR}/recipes-*/*/*/*.bbappend"

METAAZBOX_BASE := '${@os.path.normpath("${LAYERDIR}/../")}'
# Prevent current directory creeping into sstate objects. Otherwise, building
# in another TOPDIR will cause recipes using this variable to be rebuilt.
METAAZBOX_BASE[vardepvalue] = 'meta-azbox'

FULL_OPTIMIZATION_azboxhd = "-Os -pipe ${DEBUG_FLAGS}"
O2_OPT_azboxhd = "-Os -pipe ${DEBUG_FLAGS}"
O3_OPT_azboxhd = "-Os -pipe ${DEBUG_FLAGS}"
```

## conf/machine/azboxhd.conf
```bitbake
#@TYPE: Machine
#@NAME: AZBox HD
#@DESCRIPTION: Machine configuration for the AZBox HD

require conf/machine/include/azbox.inc

MACHINE_ESSENTIAL_EXTRA_RDEPENDS += "\
	kernel-module-rt61pci \
	kernel-module-rt2x00pci \
	kernel-module-rt2x00lib \
	kernel-module-mac80211 \
	kernel-module-eeprom_93cx6 \
	rt61-firmware \
	"

do_image_azboxcramfs[depends] += "${MACHINE}-buildimage-native:do_populate_sysroot"

MACHINE_FEATURES += "ci smallflash SCART YUV RCA"

SOC_FAMILY = "smp8634"

KERNEL_MODULE_AUTOLOAD += "\
	rt61pci \
	rt2x00pci \
	rt2x00lib \
	mac80211 \
	eeprom_93cx6 \
	"

IMAGE_FSTYPES = "azboxcramfs"

IMAGE_CMD_azboxcramfs_append = " \
    rm -fR ${IMAGE_ROOTFS}/boot/*; \
    mkfs.cramfs ${IMAGE_ROOTFS} ${DEPLOY_DIR_IMAGE}/azboxhd.cramfs; \
    pack_e2 -t Vision \
    -d Vision \
    -a Enigma2 \
    -v ${VISIONVERSION}-${VISIONREVISION} \
    -i ${DEPLOY_DIR_IMAGE}/azboxhd.cramfs \
    -k ${DEPLOY_DIR_IMAGE}/zbimage-linux-xload -K ULK-${KERNELVERSION} \
    -p ${DEPLOY_DIR_IMAGE}/patch.e2; \
    rm -f ${DEPLOY_DIR_IMAGE}/*.tgz; \
    rm -f ${DEPLOY_DIR_IMAGE}/*.cramfs; \
    rm -f ${DEPLOY_DIR_IMAGE}/*.zip; \
    cd ${DEPLOY_DIR_IMAGE}; \
    zip ${IMAGE_NAME}_azup.zip patch.e2; \
    rm -f ${DEPLOY_DIR_IMAGE}/*.e2; \
"

TARGET_ARCH = "mipsel"
DEFAULTTUNE = "mips32el"

# Image fails to boot if kernel exceeds some limit
KERNEL_IMAGE_MAXSIZE = "6815744"

RCNAME = "azboxhd"
```

## conf/machine/azboxme.conf
```bitbake
#@TYPE: Machine
#@NAME: AZBox Me
#@DESCRIPTION: Machine configuration for the AZBox Me

require conf/machine/include/azbox.inc

MACHINE_FEATURES += "YUV RCA"

SOC_FAMILY = "smp8655"

IMAGE_CMD_jffs2_append = " \
    rm -f ${DEPLOY_DIR_IMAGE}/*.bin; \
    rm -f ${DEPLOY_DIR_IMAGE}/*.tgz; \
    rm -f ${DEPLOY_DIR_IMAGE}/*.zip; \
    rm -f ${DEPLOY_DIR_IMAGE}/WEBIF/*.zip; \
    cp ${DEPLOY_DIR_IMAGE}/zbimage-linux-xload ${DEPLOY_DIR_IMAGE}/WEBIF/; \
    cp ${DEPLOY_DIR_IMAGE}/image0.jffs2 ${DEPLOY_DIR_IMAGE}/WEBIF/flash.jffs2; \
    tar -C ${DEPLOY_DIR_IMAGE}/WEBIF/ -cf ${DEPLOY_DIR_IMAGE}/WEBIF/webif-update.tar . ; \
    cd ${DEPLOY_DIR_IMAGE}/WEBIF && zip ${IMAGE_NAME}_webif.zip webif-update.tar; \
    rm -f ${DEPLOY_DIR_IMAGE}/WEBIF/*.tar; \
    rm -f ${DEPLOY_DIR_IMAGE}/WEBIF/*.jffs2; \
    rm -f ${DEPLOY_DIR_IMAGE}/WEBIF/zbimage-linux-xload; \
    wget -nc -P ${DEPLOY_DIR_IMAGE}/USB/ http://source.mynonpublic.com/azbox/me/update.ext; \
    cp ${DEPLOY_DIR_IMAGE}/zbimage-linux-xload ${DEPLOY_DIR_IMAGE}/USB/; \
    cp ${DEPLOY_DIR_IMAGE}/image0.jffs2 ${DEPLOY_DIR_IMAGE}/USB/; \
    rm -f ${DEPLOY_DIR_IMAGE}/*.jffs2; \
    rm -f ${DEPLOY_DIR_IMAGE}/USB/*.zip; \
    cd ${DEPLOY_DIR_IMAGE}; \
    zip -j ${IMAGE_NAME}_usb.zip USB/*; \
    rm -f ${DEPLOY_DIR_IMAGE}/USB/*.jffs2; \
    rm -f ${DEPLOY_DIR_IMAGE}/USB/zbimage-linux-xload; \
    mv ${DEPLOY_DIR_IMAGE}/${IMAGE_NAME}_usb.zip ${DEPLOY_DIR_IMAGE}/USB/; \
    "
```

## conf/machine/include/azbox-331.inc
```bitbake
# We know about rtc
include conf/machine/include/build-extras.inc

MACHINE_ESSENTIAL_EXTRA_RDEPENDS += "\
    azbox-dvb-modules-331 \
    "

DVBPROVIDER = "kernel"

MACHINE_EXTRA_RRECOMMENDS += "\
    azbox-compat \
    azbox-mrua \
    "

DVBMEDIASINK_CONFIG = "--with-wma --with-wmv --with-pcm --with-dtsdownmix --with-azbox"

MACHINE_FEATURES += " azbox alsa usbhost wifi nl80211 3dtv switchoff lpcm textlcd 32bpp hdtv dvbapi5 dvb-c blindscan-dvbs"

PREFERRED_PROVIDER_virtual/kernel = "linux-azbox"
PREFERRED_VERSION_linux-azbox = "3.3.1"
PREFERRED_PROVIDER_virtual/blindscan-dvbs = "azbox-blindscan-dvbs-utils"
PREFERRED_VERSION_rt8812au = "4.3.14"

GLIBC_EXTRA_OECONF = "--with-tls --with-__thread"

require conf/machine/include/tune-mips32.inc
require conf/machine/include/soc-family.inc
include conf/machine/include/autoload-filesystems.inc

SYSVINIT_ENABLED_GETTYS = ""
```

## conf/machine/include/azbox.inc
```bitbake
# We know about rtc
MACHINE_FEATURES_BACKFILL_CONSIDERED += "rtc"

KERNELVERSION = "3.9.2"

BOX_BRAND = "azbox"

MACHINE_ESSENTIAL_EXTRA_RDEPENDS += "\
	azbox-compat \
	azbox-dvb-modules-${MACHINE} \
	azbox-mrua-${MACHINE} \
	enigma2-plugin-systemplugins-rtisys \	
	enigma2-plugin-systemplugins-videosettingssetup \
	"

EXTRA_IMAGEDEPENDS += "\
	kmod-native \
	"

DVBPROVIDER = "kernel"

DVBMEDIASINK_CONFIG = "--with-wma --with-wmv --with-pcm --with-dtsdownmix"

MACHINE_FEATURES += "azbox alsa usbhost nl80211 switchoff lpcm textlcd 32bpp dvbapi5 dvb-c blindscan-dvbs HDMI"

PREFERRED_PROVIDER_virtual/kernel = "linux-azbox"
PREFERRED_VERSION_linux-azbox = "${KERNELVERSION}"
PREFERRED_PROVIDER_virtual/blindscan-dvbs = "azbox-blindscan-dvbs-utils"

GLIBC_EXTRA_OECONF = "--with-tls --with-__thread"

require conf/machine/include/tune-mips32.inc
require conf/machine/include/soc-family.inc

SYSVINIT_ENABLED_GETTYS = ""

BLINDSCAN_BINARY = "avl_azbox_blindscan"
```
